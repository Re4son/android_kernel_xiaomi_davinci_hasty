## drivers/net/wireless/realtek/Kconfig.rej
```kconfig
--- drivers/net/wireless/realtek/Kconfig
+++ drivers/net/wireless/realtek/Kconfig
@@ -14,5 +14,6 @@ if WLAN_VENDOR_REALTEK
 source "drivers/net/wireless/realtek/rtl818x/Kconfig"
 source "drivers/net/wireless/realtek/rtlwifi/Kconfig"
 source "drivers/net/wireless/realtek/rtl8xxxu/Kconfig"
+source "drivers/net/wireless/realtek/rtl8812au/Kconfig"
 
 endif # WLAN_VENDOR_REALTEK
```
